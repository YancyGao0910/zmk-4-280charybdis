## boards/shields/charybdis_dongle_no_touch/Kconfig.shield
```kconfig
config SHIELD_CHARYBDIS_DONGLE_NO_TOUCH
	def_bool $(shields_list_contains,charybdis_dongle_no_touch)
```

## boards/shields/charybdis_dongle_prospector/Kconfig.shield
```kconfig
config SHIELD_CHARYBDIS_DONGLE_PROSPECTOR
	def_bool $(shields_list_contains,charybdis_dongle_prospector)
```

## boards/shields/charybdis_dongle_touch/Kconfig.shield
```kconfig
config SHIELD_CHARYBDIS_DONGLE_TOUCH
	def_bool $(shields_list_contains,charybdis_dongle_touch)
```
